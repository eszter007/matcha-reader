<footer class="site-footer">
  <div class="footer-inner">
    <div class="footer-main">
      <div class="footer-brand"><a class="brand-link" href="/"><img class="brand-logo" src="/assets/matcha-icon.svg" alt="" width="28" height="28" />Matcha <span class="brand-reader">Reader</span></a><p>E-reader firmware for reading Japanese and Chinese, built on CrossPoint Reader.</p></div>
      <nav class="footer-project"><span class="footer-label">Project</span><a href="https://github.com/eszter007/matcha-reader" target="_blank" rel="noopener noreferrer">GitHub</a><a href="https://crosspointreader.com/" target="_blank" rel="noopener noreferrer">CrossPoint Reader</a></nav>
    </div>
    <div class="footer-bottom"><span>Matcha Reader is open-source under the MIT license.</span><span>Built by the community, for the community.</span></div>
  </div>
</footer>
