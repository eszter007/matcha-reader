#include "CoverWorker.h"

#include <Bitmap.h>
#include <Epub.h>
#include <FsHelpers.h>
#include <HalStorage.h>
#include <Logging.h>
#include <MangaPanel.h>
#include <Xtc.h>

namespace {
// Cover art is 2:3. Thumbs are checked against both dimensions, not just the height.
constexpr int COVER_ASPECT_NUM = 2;
constexpr int COVER_ASPECT_DEN = 3;
// The conversion path opens an EPUB (XML parse, zip inflate) on this stack.
constexpr uint32_t COVER_WORKER_STACK = 8192;
}  // namespace

bool CoverWorker::thumbHeightValid(const std::string& thumbPath, const int h) {
  // Width must match the cover box too, not just the height: thumbs generated by an earlier
  // build are exactly `h` tall but narrower, which still needs a crop at draw time -- the slow
  // per-pixel path (~250ms per cover, and clicks are dropped during such a render). Checking
  // only the height let those survive forever.
  const int expectedW = (h * COVER_ASPECT_NUM) / COVER_ASPECT_DEN;
  HalFile f;
  if (!Storage.openFileForRead("LIB", thumbPath, f)) return false;
  Bitmap bmp(f);
  bool ok = bmp.parseHeaders() == BmpReaderError::Ok && bmp.getHeight() == h && bmp.getWidth() == expectedW;
  if (ok) {
    // The header alone does not prove the pixels are there: a generation that ran out of
    // memory (reported from an X3, whose larger viewport leaves less headroom) leaves a
    // truncated file whose header still reads correctly, and it then survives forever because
    // the height matches. Require the full pixel payload -- rows are 4-byte aligned.
    const uint32_t needed = static_cast<uint32_t>(bmp.getRowBytes()) * static_cast<uint32_t>(bmp.getHeight());
    // Compare against the pixel payload only; any sane header size is on top of it.
    if (static_cast<uint32_t>(f.size()) < needed) {
      LOG_DBG("LIB", "Discarding truncated thumb %s (%u < %u bytes)", thumbPath.c_str(), (unsigned)f.size(),
              (unsigned)needed);
      ok = false;
    }
  }
  f.close();
  return ok;
}

void CoverWorker::trampoline(void* ctx) { static_cast<CoverWorker*>(ctx)->loop(); }

bool CoverWorker::shouldCancel(void* ctx) {
  auto* self = static_cast<CoverWorker*>(ctx);
  if (!self) return true;
  // NOT RenderLock::peek(). A redraw is not a reason to abandon a conversion: the worker is its
  // own FreeRTOS task, SD access is already serialised by HalStorage's mutex, and the Library's
  // own scan slices redraw often enough that any conversion longer than the gap between them was
  // cancelled and restarted from zero forever (device log: a 43KB BMP cover reached ~8s, was
  // cancelled, and began again -- it could never finish). Real user input still cancels
  // immediately: the owning screen calls requestCancel() on anyButtonDownRaw().
  const bool cancel = self->exitRequested_ || self->cancelRequested_;
  if (cancel) self->cancelSeen_ = true;
  return cancel;
}

void CoverWorker::loop() {
  while (true) {
    ulTaskNotifyTake(pdTRUE, portMAX_DELAY);
    if (exitRequested_) break;
    if (!busy_.load(std::memory_order_acquire)) continue;
    runJob();
    // Publishes result_ to the loop task.
    busy_.store(false, std::memory_order_release);
  }
  exited_ = true;
  vTaskDelete(nullptr);
}

void CoverWorker::runJob() {
  Result result;
  result.book = job_.book;
  result.fileSize = job_.fileSize;
  result.modifiedStamp = job_.modifiedStamp;

  const bool isEpub = FsHelpers::hasEpubExtension(result.book.path);
  const bool isXtc = FsHelpers::hasXtcExtension(result.book.path);
  if (!isEpub && !isXtc) {
    const manga::MangaBook mangaBook(result.book.path);
    for (const int targetHeight : job_.targetHeights) {
      if (targetHeight <= 0 || shouldCancel(this)) continue;
      if (thumbHeightValid(mangaBook.getThumbBmpPath(targetHeight), targetHeight)) continue;
      Storage.remove(mangaBook.getThumbBmpPath(targetHeight).c_str());
      mangaBook.generateThumbBmp(targetHeight, &shouldCancel, this);
    }
    result.hasGridThumb = thumbHeightValid(mangaBook.getThumbBmpPath(job_.gridHeight), job_.gridHeight);
    if (result.hasGridThumb) result.book.coverBmpPath = mangaBook.getThumbBmpPath();
  } else if (isEpub) {
    Epub epub(result.book.path, "/.crosspoint");
    const bool loaded = epub.load(true, true, &shouldCancel, this);
    // Every requested height, off the one load. A cancel between sizes still leaves the ones
    // already written on disk, so the next pass has less to do rather than starting over.
    for (const int targetHeight : job_.targetHeights) {
      if (targetHeight <= 0) continue;
      if (!loaded || shouldCancel(this)) break;
      if (thumbHeightValid(epub.getThumbBmpPath(targetHeight), targetHeight)) continue;
      epub.generateThumbBmp(targetHeight, &shouldCancel, this);
    }
    result.hasGridThumb = loaded && thumbHeightValid(epub.getThumbBmpPath(job_.gridHeight), job_.gridHeight);
    if (result.hasGridThumb) result.book.coverBmpPath = epub.getThumbBmpPath();
    if (loaded && !epub.getTitle().empty()) result.book.title = epub.getTitle();
    // Separate "there is nothing to render" from "it did not fit right now". Only a book that
    // loaded and declares no cover is a permanent fact worth recording; a failure with a cover
    // present must stay retryable, or one low-heap moment costs the cover forever. Requires
    // !cancelled: a cancelled load leaves the metadata cache unpopulated, which hasCoverImage()
    // cannot distinguish from a coverless book.
    result.coverKnownAbsent = loaded && !result.hasGridThumb && !shouldCancel(this) && !epub.hasCoverImage();
    // The other permanent outcome: the book HAS a cover, but it can never be converted by this
    // build (source beyond the JPEG decoder's dimension limits). Distinguished at the source by
    // the converter -- a low-heap moment, a cancellation and a decode error all leave this false
    // and stay retryable. Without it an unconvertible cover is re-extracted and re-decoded on
    // every Library pass forever, which on a tight device is a hot loop of SD reads (X3 report).
    if (loaded && !result.hasGridThumb && !shouldCancel(this) && epub.coverUnsupported()) {
      LOG_ERR("RBA", "Cover unconvertible for %s; recording as coverless", result.book.path.c_str());
      result.coverKnownAbsent = true;
    }
    // Deliberately NOT extended to a book that failed to OPEN. contentaccess::open() reports a
    // missing credential and an OOM through the same channel as a bad container, and the index
    // entry is keyed on size+stamp -- so recording "no cover" would outlive the credential being
    // added and the cover would never come back. It stays retryable; what it must not do is
    // stall the scan, which the completed flag below handles.
    if (loaded && !result.hasGridThumb && !result.coverKnownAbsent) {
      LOG_ERR("RBA", "Cover thumb failed for %s; will retry", result.book.path.c_str());
    }
  } else {
    Xtc xtc(result.book.path, "/.crosspoint");
    const bool loaded = xtc.load();
    for (const int targetHeight : job_.targetHeights) {
      if (targetHeight <= 0) continue;
      if (!loaded || shouldCancel(this)) break;
      if (thumbHeightValid(xtc.getThumbBmpPath(targetHeight), targetHeight)) continue;
      xtc.generateThumbBmp(targetHeight, &shouldCancel, this);
    }
    result.hasGridThumb = loaded && thumbHeightValid(xtc.getThumbBmpPath(job_.gridHeight), job_.gridHeight);
    if (result.hasGridThumb) result.book.coverBmpPath = xtc.getThumbBmpPath();
    if (loaded && !xtc.getTitle().empty()) result.book.title = xtc.getTitle();
  }

  // "Completed" must mean the job ran its course, not that nobody touched a button while it did.
  // cancelSeen_ is the honest signal: shouldCancel() sets it only when the job actually consulted
  // it and bailed. cancelRequested_ alone is just "a key went down", and including it stalled the
  // cursor on any job that never consults shouldCancel -- notably a contentaccess::open()
  // failure, which gives up in ~380ms without asking. That book was then retried forever and
  // every book behind it stayed coverless (device log: the same unopenable EPUB reloaded at
  // [177406], [182039], [563346]).
  result.completed = !cancelSeen_ && !exitRequested_;
  result.pending = true;
  result_ = std::move(result);
}

bool CoverWorker::post(Job&& job) {
  if (!task_ || busy_.load(std::memory_order_acquire) || result_.pending) return false;
  // Preserves the old "no explicit target means the grid height" fallback in one place, now that
  // callers queue a set rather than picking a single size.
  if (job.targetHeights[0] == 0) job.addTargetHeight(job.gridHeight);
  job_ = std::move(job);
  result_ = Result{};
  cancelRequested_ = false;
  cancelSeen_ = false;
  // Publishes job_ to the worker task.
  busy_.store(true, std::memory_order_release);
  xTaskNotifyGive(task_);
  return true;
}

bool CoverWorker::start(const char* taskName) {
  exitRequested_ = false;
  exited_ = false;
  busy_.store(false, std::memory_order_relaxed);
  cancelRequested_ = false;
  cancelSeen_ = false;
  result_ = Result{};
  if (xTaskCreate(&trampoline, taskName, COVER_WORKER_STACK, this, 1, &task_) != pdPASS) {
    task_ = nullptr;
    LOG_ERR("RBA", "Failed to create cover worker; missing covers will wait for the next visit");
    return false;
  }
  return true;
}

void CoverWorker::stop() {
  if (!task_) return;
  exitRequested_ = true;
  cancelRequested_ = true;
  xTaskNotifyGive(task_);
  while (!exited_) vTaskDelay(1);
  task_ = nullptr;
}
